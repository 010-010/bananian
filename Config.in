## Config.in
```kconfig
# vim: ft=kconfig

mainmenu "Bananian Configuration"

source "devices/Config.in"
	
menu "Packages"

source "packages/Config.in"

endmenu

config CONFIG_HOSTNAME
	string "Host name"
	default "bananaphone"
	help
	  The name of the device in the network
```

## devices/Config.in
```kconfig
# vim: ft=kconfig

config CONFIG_DEV_KERNEL
	string

choice CONFIG_DEVICE
	prompt "Device model"
	default CONFIG_DEVICE_ARGON

source "devices/argon/Config.in"

endchoice
```

## devices/argon/Config.in
```kconfig
# vim: ft=kconfig

config CONFIG_DEVICE_ARGON
	bool "Nokia 8110 4G (nokia-argon)"
	select CONFIG_PACKAGE_DEVICE_MODEM_QCOM
	select CONFIG_PACKAGE_DEVICE_STARTUP_ARGON
	select CONFIG_PACKAGE_ALSA_CONF_MSM8905
```
